## package/libs/openssl/Config.in
```kconfig
if PACKAGE_libopenssl

config OPENSSL_WITH_EC
	bool
	default y
	prompt "Enable elliptic curve support"
	help
		Elliptic-curve cryptography (ECC) is an approach to public-key
		cryptography based on the algebraic structure of elliptic curves
		over finite fields. ECC requires smaller keys compared to non-ECC
		cryptography to provide equivalent security.

config OPENSSL_WITH_EC2M
        bool
        depends on OPENSSL_WITH_EC
        prompt "Enable ec2m support"
	help
		This option enables the more efficient, yet less common, binary
		field elliptic curves.

config OPENSSL_WITH_DTLS
	bool
	default n
	prompt "Enable DTLS support"
	help
		Datagram Transport Layer Security (DTLS) provides TLS-like security
		for datagram-based (UDP, DCCP, CAPWAP, SCTP & SRTP) applications.

config OPENSSL_WITH_COMPRESSION
	bool
	default n
	prompt "Enable compression support"
	help
		TLS compression is not recommended, as it is deemed insecure.
		The CRIME attack exploits this weakness.
		Even with this option turned on, it is disabled by default, and the
		application must explicitly turn it on.

config OPENSSL_WITH_PSK
	bool
	default y
	prompt "Enable PSK support"
	help
		Build support for Pre-Shared Key based cipher suites.

config OPENSSL_WITH_SRP
	bool
	default y
	prompt "Enable SRP support"
	help
		The Secure Remote Password protocol (SRP) is an augmented
		password-authenticated key agreement (PAKE) protocol, specifically
		designed to work around existing patents.

config OPENSSL_WITH_DEPRECATED
	bool
	default y
	prompt "Include deprecated APIs (See help for a list of packages that need this)"
	help
		Since openssl 1.1.0 is still new to openwrt, some packages
		requiring this option do not list it as a requirement yet.
		Packages requiring this option and not listing it as a requirement:
		 * hostapd, freeswitch-stable, freeswitch, python, python3, squid.

config OPENSSL_OPTIMIZE_SPEED
	bool
	default y if x86_64 || i386
	prompt "Enable optimization for speed instead of size"
	select OPENSSL_WITH_ASM
	help
		Enabling this option increases code size (around 20%) and
		performance.  The increase in performance and size depends on the
		target CPU. EC and AES seem to benefit the most, with EC speed
		increased by 20%-50% (mipsel & x86).
		AES-GCM is supposed to be 3x faster on x86. YMMV.

config OPENSSL_WITH_ASM
	bool
	default y
	prompt "Compile with optimized assembly code"
	depends on !arc
	help
		Disabling this option will reduce code size and performance.
		The increase in performance and size depends on the target
		CPU and on the algorithms being optimized.  As of 1.1.0i*:

		Platform  Pkg Inc. Algorithms where assembly is used - ~% Speed Increase
		aarch64   174K     BN, aes, sha1, sha256, sha512, nist256, poly1305
		arm       152K     BN, aes, sha1, sha256, sha512, nist256, poly1305
		i386      183K     BN+147%, aes+300%, rc4+55%, sha1+160%, sha256+114%, sha512+270%, nist256+282%, poly1305+292%
		mipsel      1.5K   BN+97%, aes+4%, sha1+94%, sha256+60%
		mips64	    3.7K   BN, aes, sha1, sha256, sha512, poly1305
		powerpc    20K     BN, aes, sha1, sha256, sha512, poly1305
		x86_64    228K     BN+220%, aes+173%, rc4+38%, sha1+40%, sha256+64%, sha512+31%, nist256+354%, poly1305+228%

		* Only most common algorithms shown. Your mileage may vary.
		  BN (bignum) performance was measured using RSA sign/verify.

config OPENSSL_NO_SSE2
	bool
	default y if TARGET_x86_legacy || TARGET_x86_geode
	prompt "Disable use of x86 SSE2 instructions"
	help
		Use of SSE2 instructions greatly increase performance (up to
		3x faster) with a minimum (~0.2%, or 23KB) increase in package
		size, but it will bring no benefit if your hardware does not
		support them, such as Geode GX and LX.  In this case you may
		save 23KB by saying yes here.  AMD Geode NX, and Intel
		Pentium 4 and above support SSE2.
	depends on OPENSSL_WITH_ASM && i386

config OPENSSL_OTHER_OPTIONS
	bool
	default n
	prompt "Choose less commonly used build options"

config OPENSSL_WITH_CAMELLIA
	bool
	default n
	prompt "Enable Camellia cipher support"
	depends on OPENSSL_OTHER_OPTIONS
	help
		Camellia is a bock cipher with security levels and processing
		abilities comparable to AES.

config OPENSSL_WITH_IDEA
	bool
	default n
	prompt "Enable IDEA cipher support"
	depends on OPENSSL_OTHER_OPTIONS
	help
		IDEA is a block cipher with 128-bit keys.

config OPENSSL_WITH_SEED
	bool
	default n
	prompt "Enable SEED cipher support"
	depends on OPENSSL_OTHER_OPTIONS
	help
		SEED is a block cipher with 128-bit keys broadly used in
		South Korea, but seldom found elsewhere.

config OPENSSL_WITH_MDC2
	bool
	default n
	prompt "Enable MDC2 digest support"
	depends on OPENSSL_OTHER_OPTIONS

config OPENSSL_WITH_WHIRLPOOL
	bool
	default n
	prompt "Enable Whirlpool digest support"
	depends on OPENSSL_OTHER_OPTIONS

config OPENSSL_WITH_CMS
	bool
	default n
	prompt "Enable CMS (RFC 5652) support"
	depends on OPENSSL_OTHER_OPTIONS
	help
		Cryptographic Message Syntax (CMS) is used to digitally sign,
		digest, authenticate, or encrypt arbitrary message content.

config OPENSSL_WITH_RFC3779
	bool
	default n
	prompt "Enable RFC3779 support (BGP)"
	depends on OPENSSL_OTHER_OPTIONS
	help
		RFC 3779 defines two X.509 v3 certificate extensions.  The first
		binds a list of IP address blocks, or prefixes, to the subject of a
		certificate.  The second binds a list of autonomous system
		identifiers to the subject of a certificate.  These extensions may be
		used to convey the authorization of the subject to use the IP
		addresses and autonomous system identifiers contained in the
		extensions.

config OPENSSL_ENGINE
	bool "Enable engine support"
	help
		This enables alternative cryptography implementations,
		most commonly for interfacing with external crypto devices,
		or supporting new/alternative ciphers and digests.

config OPENSSL_ENGINE_CRYPTO
	bool
	select OPENSSL_ENGINE
	prompt "Acceleration support through /dev/crypto"
	help
		This enables use of hardware acceleration through OpenBSD
		Cryptodev API (/dev/crypto) interface.

config OPENSSL_ENGINE_DIGEST
	bool
	depends on OPENSSL_ENGINE_CRYPTO
	prompt "/dev/crypto digest (md5/sha1) acceleration support"

config OPENSSL_WITH_ASYNC
	bool
	default n
	prompt "Enable asynchronous jobs support"
	depends on OPENSSL_OTHER_OPTIONS && OPENSSL_ENGINE && USE_GLIBC
	help
		Enables async-aware applications to be able to use OpenSSL to
		initiate crypto operations asynchronously. In order to work
		this will require the presence of an async capable engine.

config OPENSSL_WITH_GOST
	bool
	default n
	prompt "Prepare library for external GOST engine"
	depends on OPENSSL_OTHER_OPTIONS && OPENSSL_ENGINE
	help
		This option prepares the library to accept an external
		engine, not included in standard openwrt feeds, to add
		support for Russian GOST crypto algorithms.  See
		https://github.com/gost-engine/engine

endif
```
